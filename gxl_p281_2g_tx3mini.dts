#include "gxl_p281_1g.dts"

/ {
	le-dt-id = "gxl_p281_2g_tx3mini";

	memory@00000000 {
		linux,usable-memory = <0x0 0x100000 0x0 0x7ff00000>;
	};

	fd628_dev {
		compatible = "amlogic,fd628_dev";
		status = "okay";
		fd628_gpio_clk = <&gpio GPIODV_27 GPIO_ACTIVE_HIGH>;
		fd628_gpio_dat = <&gpio GPIODV_26 GPIO_ACTIVE_HIGH>;
		fd628_gpio_stb = <&gpio_ao GPIOAO_4 GPIO_ACTIVE_HIGH>;
		/* < DHHMM > Order of display chars (D=dots, represented by a single char) */
		fd628_chars = /bits/ 8 <4 3 2 1 0>;
		/* Dot enumeration */
		/* Alarm = 0, USB = 1, Play = 2, Pause = 3, Col = 4, Eth = 5, Wifi = 6 */
		fd628_dot_bits = /bits/ 8 <0 1 2 3 4 5 6>;
		/* Display type: 0 = Unknown, 1 = Common Cathode, 2 = Common Anode */
		/* Type 1 usually has Alarm, USB, Play, Pause, Col, Ethernet, Wifi dots */
		/* Type 2 usually has APPS, USB, SETUP, CARD, Col, HDMI, CVBS dots */
		fd628_display_type = /bits/ 32 <1>;
	};

};
