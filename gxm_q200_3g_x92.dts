#include "gxm_q200_3g.dts"

/ {
	le-dt-id = "gxm_q200_3g_x92";

	fd628_dev {
		compatible = "amlogic,fd628_dev";
		status = "okay";
		fd628_gpio_clk = <&gpio GPIODV_16 GPIO_ACTIVE_HIGH>;
		fd628_gpio_dat = <&gpio GPIODV_15 GPIO_ACTIVE_HIGH>;
		fd628_gpio_stb = <&gpio GPIODV_17 GPIO_ACTIVE_HIGH>;
		/* < DHHMM > Order of display chars (D=dots, represented by a single char) */
		fd628_chars = /bits/ 8 <4 0 1 2 3>;
		/* Dot enumeration */
		/* Alarm = 0, USB = 1, Play = 2, Pause = 3, Col = 4, Eth = 5, Wifi = 6 */
		fd628_dot_bits = /bits/ 8 <0 1 2 3 4 5 6>;
		/* Display type: 0 = Unknown, 1 = Common Cathode, 2 = Common Anode */
		/* Type 1 usually has Alarm, USB, Play, Pause, Col, Ethernet, Wifi dots */
		/* Type 2 usually has APPS, USB, SETUP, CARD, Col, HDMI, CVBS dots */
		fd628_display_type = /bits/ 32 <2>;
	};

};
